## zephyr/Kconfig
```kconfig
config OPENBMC_PHOSPHOR_TIME_MANAGER
    bool "openbmc phosphor time manager"

config OPENBMC_PHOSPHOR_TIME_MANAGER_NTP
    bool "SNTP client (NTP time sync)"
    default y
    depends on OPENBMC_PHOSPHOR_TIME_MANAGER
    depends on SNTP
    help
      Build zephyr/ntp_time.c (the SNTP client thread) and
      zephyr/ntp_config.cpp (the D-Bus object that stores the server list).
      Disable it for a build that only ever sets the time manually:
      timedated still provides SetTime, but nothing syncs and the
      StaticNTPServers property does not exist.

config OPENBMC_PHOSPHOR_TIME_MANAGER_NTP_SERVER
    string
    prompt "NTP server address (empty = NTP sync disabled)"
    default ""
    depends on OPENBMC_PHOSPHOR_TIME_MANAGER_NTP
    help
      NTP server address, either an IPv4 literal or a host name. Leave it
      empty to disable the built-in server; the sync thread then only polls
      the servers the user stored through StaticNTPServers, if any.

config OPENBMC_PHOSPHOR_TIME_MANAGER_NTP_PORT
    int
    prompt "NTP server UDP port"
    default 123
    depends on OPENBMC_PHOSPHOR_TIME_MANAGER_NTP_SERVER != ""
    help
      The standard NTP port is 123. Change it when that port is taken on the
      server side.
```
